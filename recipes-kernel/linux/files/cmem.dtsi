/ {
        cmem {
                compatible = "ti,cmem";
                #address-cells = <1>;
                #size-cells = <0>;

		#pool-size-cells = <1>;

                status = "disabled";
        };

};
